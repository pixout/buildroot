## package/pixout/libglib2a/Config.in
```kconfig
config BR2_PACKAGE_LIBGLIB2A
	bool "libglib2a"
	depends on BR2_USE_WCHAR # gettext
	depends on BR2_USE_MMU # fork()
	select BR2_PACKAGE_LIBFFI
	select BR2_PACKAGE_PCRE
	select BR2_PACKAGE_ZLIB
	help
	  Low-level core library that forms the basis of GTK+ and GNOME.

	  http://www.gtk.org/

comment "libglib2a requires a toolchain with WCHAR support"
	depends on !BR2_USE_WCHAR
```

## package/pixout/qtbasepx/Config.in
```kconfig
config BR2_PACKAGE_QTBASEPX
	bool "qtbasepx"
	select BR2_PACKAGE_PKGCONF
	select BR2_PACKAGE_EUDEV
	select BR2_PACKAGE_LIBGLIB2A
	select BR2_PACKAGE_ZLIB
	select BR2_PACKAGE_JPEG
	select BR2_PACKAGE_LIBPNG
	select BR2_PACKAGE_TIFF
	select BR2_PACKAGE_FREETYPE
	select BR2_PACKAGE_DBUS
	select BR2_PACKAGE_OPENSSL
	select BR2_PACKAGE_SQLITE
	select BR2_PACKAGE_ALSA_LIB
	help
		Qt 5 qtbase module
```

## package/pixout/qtxmlpatternspx/Config.in
```kconfig
config BR2_PACKAGE_QTXMLPATTERNSPX
	bool "qtxmlpatternspx"
	select BR2_PACKAGE_QTBASEPX
	help
		Qt 5 xmlpatterns module
```

## package/pixout/upstart/Config.in
```kconfig
config BR2_PACKAGE_UPSTART
	bool "upstart"
	default y
	depends on BR2_ROOTFS_DEVICE_CREATION_DYNAMIC_EUDEV
	depends on BR2_TOOLCHAIN_HAS_THREADS # dbus
	select BR2_PACKAGE_DBUS
	select BR2_PACKAGE_LIBNIH
	select BR2_PACKAGE_JSON_C
	help
		Upstart is an event-based replacement for the /sbin/init
		daemon which handles starting of tasks and services
		during boot, stopping them during shutdown and supervising 
		them while the system is running.


comment "upstart meeds a toolchain w/ threads"
	depends on !BR2_TOOLCHAIN_HAS_THREADS
```
